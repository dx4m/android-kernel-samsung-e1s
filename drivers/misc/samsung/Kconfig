## drivers/net/wireless/pcie_scsc/Kconfig
```kconfig
config SCSC_WLAN
	tristate "Driver for Samsung SCSC Maxwell Wifi"
	depends on SCSC_CORE
	depends on CFG80211
	default n

if SCSC_WLAN != n
config SCSC_WLAN_KEY_MGMT_OFFLOAD
        bool "Enable roam offload for SCSC WLAN"
        default y
        help
          This option enables roam offload for SCSC WLAN.

config SCSC_WLAN_HIP4_PROFILING
	bool "Enable HIP4 profiling"
	default n
	depends on SCSC_WLAN
	help
	  This option enables HIP4 profiling

config SCSC_WLAN_DEBUG
	bool "Enable debug output from the SCSC Wifi driver"
	depends on SCSC_WLAN
	select SCSC_WLAN_HIP4_PROFILING
	help
	  This option enables debug support for the SCSC wifi chipset.

config SCSC_WLAN_SG
	bool "Enable SCSC WLAN Scatter-gather and GSO support"
	depends on SCSC_WLAN
        default n
	help
	  This option enables scatter-gather and GSO feature

config SCSC_WLAN_RX_NAPI
	bool "Enable use of net device napi rx polling api"
	default y
	help
	  This option enables the drivers use of the napi api

config SCSC_WLAN_RX_NAPI_GRO
	bool "Enable use of net device napi rx GRO"
	depends on SCSC_WLAN_RX_NAPI
	default n
	help
	  This option enables the drivers use of the napi Generic Receive Offload

config SCSC_WLAN_NAPI_PER_NETDEV
	bool "Add napi instance per each netdevice"
	depends on SOC_S5E9945 || SOC_S5E9955
	default y
	help
	  This option enables the drivers to allow one netdevice to have one napi instance.

config SCSC_WLAN_ANDROID
	bool "Android specific support"
	default y
	help
	  Enable support for Android specific aspects of the driver.

config SCSC_WLAN_STA_ONLY
	bool "Support WLAN STA only (no P2P/AP/IBSS)"
	default n
	help
	  Enable only basic STA mode for debugging purposes

config SCSC_WLAN_KIC_OPS
	bool "Wi-Fi service driver provides OPS for KIC to use for various tasks"
	depends on SAMSUNG_KIC
	default y
	help
	  Provide Wi-Fi service driver OPS, which KIC can use for triggering Wi-Fi related events.

config SCSC_WLAN_GSCAN_ENABLE
	bool "Enable GSCAN in SCSC wlan driver"
	default y
	help
	  This option enables GSCAN in SCSC wlan driver.

config SCSC_WLAN_WES_NCHO
	bool "Enable NCHO/WES feature"
	default y
	help
	  This option enables the NCHO/WES feature

config SCSC_WLAN_MUTEX_DEBUG
	bool "Enable Mutex debugging mechanism in slsi wlan driver"
	default y
	help
	  This option enables the Mutex debug reports in slsi wlan driver.

config CONFIG_SCSC_WLAN_DISABLE_NAT_KA
	bool "Disable NAT"
	default n
	help
	  This option disables NAT.

config SCSC_WLAN_HANG_TEST
	bool "Test HANG Event"
	default y
	help
	   This option facilitates triggering of HANG Event
	   to reset WLAN.

config SCSC_WLAN_NAT_KEEPALIVE_DISABLE
	bool "Disable NAT KeepAlive"
	default n
	help
	  This option disables the NAT KeepAlive
	  Offload Feature.

config SCSC_WIFILOGGER
        tristate "Samsung SCSC Android Wi-Fi Logger"
        depends on SCSC_CORE
        default n

config SCSC_WIFILOGGER_DEBUGFS
        bool "Samsung SCSC Android Wi-Fi Logger DebugFS"
        depends on SCSC_WIFILOGGER && DEBUG_FS
        default y

config SCSC_WIFILOGGER_TEST
        bool "Samsung SCSC Android Wi-Fi Logger Test Harness"
        depends on SCSC_WIFILOGGER && SCSC_WIFILOGGER_DEBUGFS
        default n

config SCSC_WLAN_ENHANCED_LOGGING
	bool "Enable Enhanced Logging"
	depends on SCSC_WIFILOGGER
	default y
	help
	  This option enables the Enhanced Logging
	  Feature.

config SCSC_WLAN_ACM_API
	bool "Provide TSF read API"
	default n
	help
	  This option provides API to read TSF.

config SCSC_WLAN_MAC_ADDRESS_FILENAME
	string "MAC address filename"
	default "/efs/wifi/.mac.info"
	help
	  Select the programmed MAC address file.

config SCSC_WLAN_MAX_INTERFACES
        int "Max number of virtual interfaces supported"
        range 5 16
        default 5
        help
          The driver structures are sized to support this
          number of interfaces.

config SCSC_WLAN_WIFI_SHARING
	bool "Wifi Sharing Support"
	default n
	help
	  This option tells if wifi sharing is supported or not.

config SCSC_WLAN_WIFI_SHARING_CSA_LEGACY
	bool "Wifi Sharing CSA Host Support"
	default n
	depends on SCSC_WLAN_WIFI_SHARING
	help
	  This option tells if wifi sharing - channel switch algorithm is supported or not.

config SCSC_WLAN_ENABLE_MAC_RANDOMISATION
        bool "Wifi Mac Randomization Support"
        default n
        help
          This option tells if mac randomization is supported or not.

config SCSC_AP_INTERFACE_NAME
        string "AP net device interface name"
        default "wlan1"
        help
          AP net device interface name.

config SCSC_WLAN_ACS_ENABLE
        bool "ACS Support"
        default y
        help
          This option tells if automatic channel selection is
	  supported or not.

config SCSC_WLAN_MHS_STATIC_INTERFACE
        bool "Static AP Interface Support"
        default n
        help
          This option tells if AP interface has been created
          statically or dynamically.
          is enabled or not.

config SCSC_WLAN_PRIORITISE_IMP_FRAMES
        bool "Change priority of important frames such as DNS, MDNS, TCP SYN"
        depends on SOC_EXYNOS9610
        default y
        help
          The option enables the driver to prioritise important frames
          (such as DNS, MDNS, TCP SYN) so that they are sent ahead of others.

config SCSC_WIFI_NAN_ENABLE
        bool "Enable WiFi NAN"
        default n
        help
          This option tells whether WiFi NAN is enabled or not.

config SCSC_WIFI_NAN_PAIRING
        bool "Enable WiFi NAN Pairing"
        depends on SCSC_WIFI_NAN_ENABLE
        default n
        help
          This option tells whether WiFi NAN Pairing is enabled or not.

config SCSC_WLAN_ENHANCED_PKT_FILTER
        bool "Enable enhanced packet filtering in suspend"
        default n
        help
          This option tells if UDP packet filtering in suspend is
          supported or not.

config SCSC_ENHANCED_PACKET_STATS
        bool "Enable enhanced packet stats"
        default n
        help
          This option tells whether enhanced packet stats collection
          is enabled or not.

config SCSC_WLAN_LOW_LATENCY_MODE
        bool "Support enabling/disabling roaming as per latency mode"
        default n
        help
          This option tells whether support is provided for enabling
          or disabling roaming as per the latency mode.

config SCSC_WLAN_SET_PREFERRED_ANTENNA
        bool "Enable the driver to set preferred antenna"
        default y
        help
          This option enables the driver to set the preferred antenna.

config SLSI_WLAN_STA_FWD_BEACON
        bool "Forwarding beacon support"
	default y
        help
          This option tells if beacon forwarding in STA mode is enabled or not.
          When it is enabled, Driver deliver beacon info of connected AP to Supplicant.

config SCSC_WLAN_STA_ENHANCED_ARP_DETECT
        bool "Enable enhanced arp detection"
        default n
        help
          This option tells whether enhanced arp detection
          is enabled or not.

config SCSC_WLAN_DUAL_STATION
        bool "Enable dual station"
        default n
        help
        This option tells if dual station feature is supported or not.

config SCSC_WLAN_MAX_LINK_SPEED
        bool "Enable max link speed calculation"
        default n
        help
        This option tells if max linkspeed calculation is enabled or not.

config SCSC_WLAN_ARP_FLOW_CONTROL
        bool "Enable ARP flow control between Host and FW"
        default y
        help
        This option tells if ARP flow control between Host and FW is enabled or not.

config SCSC_WLAN_AP_AUTO_RECOVERY
        bool "Enable auto recovery for AP mode."
        default n
        help
        This option tells if auto recovery in AP mode is enabled or not.

config SCSC_WLAN_FORCE_SILENT_RECOVERY
        bool "Enable force to silent recovery"
        default y
	depends on SOC_S5E9945 || SOC_S5E9955
        help
        This option tells if it is enabled or not to force to silent recovery.

config SCSC_WLAN_DYNAMIC_ITO
        bool "Enable dynamic ito"
        default n
        help
        This option tells if dynamic ito feature is supported or not.

config SCSC_WLAN_MAC_ACL_PER_MAC
        bool "Enable handling of MAC ACL list, received as multiple requests"
        default n
        help
        This option tells if Driver handles MAC ACL list, received as multiple requests.

config SCSC_WLAN_ENHANCED_BIGDATA
        bool "Send SCSC panic records on HANGED_EVENT"
        default y
        help
        Enable this option to send panic records when HANGED_EVENT
        is issued by the driver on FW panic.

config SCSC_WLAN_HE
        bool "Enable HE Capability in Driver"
	default n
        help
        Enable HE Capability in Driver.

config SCSC_WLAN_EHT
        bool "Enable EHT Capability in Driver"
        default n
        help
        Enable EHT Capability in Driver.

config SCSC_CFG80211_EHT_STA_PROFILE_PARSE
        bool "Enable EHT station profile parsing in Driver"
        default n
        help
        This option parses Multi link probe response for station profile

config SCSC_EHT_CONNECTION_EMLMR
        bool "EMLR support checking in Driver during connection"
        default n
        help
        This option enables EMLMR support during connection

config SCSC_WLAN_BSS_COLOR
	bool "Enable making a bss color IE in kernel 5.4"
	default n
	help
	  This option enables making a bss color IE in kernel 5.4.

config SCSC_WLAN_RTT
        bool "Enable WiFi RTT"
        default n
        help
          This option tells whether WiFi RTT is enabled or not.

config SCSC_WLAN_DELAYED_SCHED_SCAN
        bool "Enable delayed scheduled scan"
        default n
        help
        This option enables the delayed scheduled scan.

config SCSC_WLAN_EXPONENTIAL_SCHED_SCAN
        bool "Enable exponential scheduled scan"
        default n
        help
        This option enables the exponential scheduled scan.

config SCSC_WLAN_OCV_SUPPORT
        bool "Enable OCV on kernel version < 5.10"
        default n
        help
        This option enables the OCV on kernel version < 5.10

config SCSC_WLAN_SAR_SUPPORTED
        bool "Enables SAR configuration through NL commands"
        default n
        help
        This option enables the SAR configuration through NL commands.

config SCSC_WLAN_DEBUG_MLME_WORK_STRUCT
        bool "Enable this to debug memory corruption in mlme work struct"
        default n
        help
        This option enables debug if memory corruption happen in mlme work struct.

config SCSC_WLAN_TX_API
        bool "Enable Tx APIs"
        default y
        depends on SOC_S5E9925 || SOC_S5E9935 || SOC_S5E9945 || SOC_S5E9955 || SOC_S5E5515 || SOC_S5E8535 || SOC_S5E8835 || SOC_S5E8845 || SOC_S5E5535
        select SCSC_WLAN_LOAD_BALANCE_MANAGER
        help
        This option enables Tx APIs.

config SCSC_WLAN_CPUHP_MONITOR
	bool "Enable CPU Hotplug Monitor"
        default y
	depends on SOC_S5E9945 || SOC_S5E8845 || SOC_S5E8835
        help
        This option enables CPU Hotplug Monitor

config SCSC_WLAN_MULTIPLE_CLUSTER
	bool "Enable Cluster2 usage"
	default y
	depends on SOC_S5E9945 || SOC_S5E9955
	help
	This option enables cluster2 usage

config SCSC_WLAN_SUPPORT_6G
        bool "Enable 6G band"
        default n
        help
        This option enables 6g band support.

config SCSC_WLAN_LOG_2_USER_SP
        bool "Enable Logging for Driver events for user space"
        default y
        help
        This option enables logging of driver events to user space

config SCSC_WLAN_LOAD_BALANCE_MANAGER
        bool "load balance manager"
        default y
        depends on SOC_S5E9925 || SOC_S5E5515 || SOC_S5E9935 || SOC_S5E9945 || SOC_S5E9955 || SOC_S5E8535 || SOC_S5E8835 || SOC_S5E8845
        help
        This option enables load balance manager.

config SCSC_WLAN_TRACEPOINT_DEBUG
        bool "Enable Tracepoint debug"
        default n
        depends on TRACEPOINTS && KRETPROBES
        help
        This option enables tracepoint debug.

config SCSC_WLAN_HIP5
	bool "Enable HIP5"
	default y
	depends on SOC_S5E9925 || SOC_S5E9935 || SOC_S5E9945 || SOC_S5E9955
	depends on SCSC_WLAN
	select SCSC_WLAN_RX_NAPI
	select SCSC_WLAN_LOAD_BALANCE_MANAGER
	help
	This option enables HIP version 5

config SCSC_WLAN_HOST_DPD
	bool "Enable support for Host DPD"
	default y
	depends on SOC_S5E8825 || SOC_S5E8835 || SOC_S5E8845 || SCSC_BB_REDWOOD
	depends on SCSC_WLAN
	help
	This option enables support for DPD in Host

config SCSC_UNII4
        bool "Support UNII4 sub band"
        default n
        depends on SCSC_WLAN
        help
        This option enables UNII4 sub band.

config SCSC_WLAN_SAP_POWER_SAVE
	bool "Enable SAP_POWER_SAVE"
	default n
	depends on SCSC_WLAN
	help
	This option enables the power_save mode of softap

config WLBT_LOCAL_MIB
	bool "Enables check local_mib file"
	default y
	help
	This option enables loading local_mib file.

config SCSC_WLAN_TPUT_MONITOR
	bool "Enable Throughput Monitor"
	default y
	help
	This option enables throughput monitor in Host

config SCSC_WLAN_KUNIT_TEST
	bool "Enable Kunit test"
	default n
	depends on KUNIT
	help
	  This option enables kunit test

config RPS
	bool "Enable RPS config"
	default n
	depends on SCSC_WLAN_KUNIT_TEST
	help
	  This option enables RPS configuration

config SCSC_WLAN_TAS
	bool "Enable WLAN TAS"
	default n
	depends on SCSC_WLAN_TX_API
	help
	  This option enables TAS in Host. Native daemon should be configured.

config SCSC_WLAN_ICTAS
	bool "Enable WLAN IC-TAS"
	default n
	help
	  This option enables C-TAS without Native daemon.

config SLSI_WLAN_LPC
	bool "Enable Local Packet Capture"
	depends on SOC_S5E9945 || SOC_S5E9955
	default y
	help
	  This option enables Local Packet Capture.

config SCSC_WLAN_OCE
	bool "OCE Support"
	default n
	help
	  This option enables OCE support in driver
config SCSC_WLAN_MAX_NDI_INTERFACES
        int "Max number of NDI ifaces supported for NAN"
        range 1 8
        default 5
        help
          The option to enable max NDI ifaces for NAN
config SCSC_WLAN_UWB_COEX
	bool "Enable SCSC_WLAN_UWB_COEX"
	depends on SOC_S5E9945
	default y
	help
	  This option enables UWB COEX
endif
config SCSC_USER_IMAGE
        bool "Enable build type as user"
        default n
        help
          This option tells whether build type is user or not

config SLSI_WLAN_CP_COEX
	bool "Enable CP coex"
	depends on SOC_S5E9945
	default y
	help
	  This option enables CP coex

config SCSC_WLAN_ADAPTIVE_TX_MOD
        bool "Enable Adaptive MOD"
        default y
        help
          This option enables dynamic MOD for each interface to balance the throughput in concurrent cases

config SLSI_WLAN_PACKET_FILETR_V2
	bool "Enable Packet Filter V2"
	depends on SOC_S5E9945
	default y
	help
	  This option enables Packet Filter V2

config SLSI_WLAN_DCTAS
        bool "Enable Direct C-TAS"
        depends on SOC_S5E9945 || SOC_S5E9955 || SOC_S5E9965
        default n
        help
          This option enables Direct C-TAS

config SLSI_WLAN_STA_W_BRIDGEDAP
        bool "Enable STA + bridged AP concurrency mode"
        default n
        help
          This option enables STA + bridged AP concurrency mode
```

## drivers/wlan/kernel_modules/Kconfig
```kconfig
source "$(KCONFIG_EXT_PREFIX)drivers/wlan/kernel_modules/ipc_logging/Kconfig"
#source "$(KCONFIG_EXT_PREFIX)drivers/wlan/kernel_modules/mhi/host/Kconfig"
#source "$(KCONFIG_EXT_PREFIX)drivers/wlan/kernel_modules/mhi/ep/Kconfig"
#source "$(KCONFIG_EXT_PREFIX)drivers/wlan/kernel_modules/mhi/devices/Kconfig"
#source "$(KCONFIG_EXT_PREFIX)drivers/wlan/kernel_modules/mhi/controllers/Kconfig"
#source "$(KCONFIG_EXT_PREFIX)drivers/wlan/kernel_modules/qmi_helpers/Kconfig"
#source "$(KCONFIG_EXT_PREFIX)drivers/wlan/kernel_modules/qrtr/Kconfig"
```
